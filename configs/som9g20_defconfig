## configs/som9g20_defconfig
```kconfig
# Architecture
BR2_arm=y
BR2_arm926t=y

# First stage bootloader
BR2_TARGET_AT91BOOTSTRAP=y
BR2_TARGET_AT91BOOTSTRAP_BOARD="at91sam9g20ek"
BR2_TARGET_AT91BOOTSTRAP_DATAFLASHCARD=y

# Second stage bootloader
BR2_TARGET_UBOOT=y
BR2_TARGET_UBOOT_BOARDNAME="at91sam9g20ek"
BR2_TARGET_UBOOT_2015_01=y

# Kernel
BR2_LINUX_KERNEL=y
BR2_LINUX_KERNEL_CUSTOM_VERSION=y
BR2_LINUX_KERNEL_CUSTOM_VERSION_VALUE="2.6.39"
BR2_LINUX_KERNEL_PATCH="ftp://www.linux4sam.org/pub/linux/2.6.39-at91/2.6.39-at91-exp.tar.gz"
BR2_LINUX_KERNEL_USE_DEFCONFIG=y
BR2_LINUX_KERNEL_DEFCONFIG="at91sam9g20ek"

# Filesystem
BR2_TARGET_ROOTFS_TAR=y

# sensys
#
BR2_DL_DIR="/usr/local/buildroot/cache"
BR2_HOST_DIR="/usr/local/som9g20"
BR2_TARGET_UBOOT_BOARDNAME="at91sam9g20ek_dataflash_cs1"
BR2_TARGET_DATAFLASHBOOT=y
BR2_TARGET_DATAFLASHBOOT_AT91RM9200=y
```
